## config/west.yml
```yaml
manifest:
  remotes:
    - name: zmkfirmware
      url-base: https://github.com/zmkfirmware
    - name: urob
      url-base: https://github.com/urob
    # - name: gpeye
    #   url-base: https://github.com/GPeye
    - name: infely
      url-base: https://github.com/infely
  projects:
    - name: zmk
      remote: zmkfirmware
      revision: main
      import: app/west.yml
    - name: zmk-helpers
      remote: urob
      revision: main
    - name: zmk-auto-layer
      remote: urob
      revision: main
    # - name: urchin-peripheral-animation
    #   remote: gpeye
    #   revision: main
    - name: nice-view-battery
      remote: infely
      revision: main
  self:
    path: config
```
