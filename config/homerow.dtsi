hml: hml {
        compatible = "zmk,behavior-hold-tap";
        bindings = <&kp>,  <&kp>;
        flavor = "balanced";
        tapping-term-ms = <HRM_TAPPING_TERM_MS>;
        quick-tap-ms = <QUICK_TAP_MS>;
        require-prior-idle-ms = <HRM_REQUIRE_PRIOR_IDLE_MS>;
        hold-trigger-on-release;
        hold-trigger-key-positions = <KEYS_R THUMBS>;
};

hmr: hmr {
        compatible = "zmk,behavior-hold-tap";
        bindings = <&kp>,  <&kp>;
        flavor = "balanced";
        tapping-term-ms = <HRM_TAPPING_TERM_MS>;
        quick-tap-ms = <QUICK_TAP_MS>;
        require-prior-idle-ms = <HRM_REQUIRE_PRIOR_IDLE_MS>;
        hold-trigger-on-release;
        hold-trigger-key-positions = <KEYS_L THUMBS>;
};
